## r528/vendor_drivers/apps/gt9271_touch_test/Kconfig
```kconfig
#
# For a description of the syntax of this configuration file,
# see the file kconfig-language.txt in the NuttX tools repository.
#

config EXAMPLES_GT9271_TOUCH_TEST
	bool "GT9271 LCD IIC Touchscreen Test Application"
	default n
	depends on GT9271_IIC_TOUCH
	---help---
		Enable the GT9271 LCD IIC touchscreen test application.
		This application tests the GT9271 touchscreen functionality
		by reading touch events and displaying touch coordinates with
		percentage positions relative to the 1200x1920 LCD screen.

if EXAMPLES_GT9271_TOUCH_TEST

config EXAMPLES_GT9271_TOUCH_TEST_PROGNAME
	string "GT9271 touch test program name"
	default "gt9271_touch_test"
	---help---
		This is the name of the program that will be used when the NSH ELF
		program is installed.

config EXAMPLES_GT9271_TOUCH_TEST_PRIORITY
	int "GT9271 touch test task priority"
	default 100

config EXAMPLES_GT9271_TOUCH_TEST_STACKSIZE
	int "GT9271 touch test stack size"
	default DEFAULT_TASK_STACKSIZE

endif # EXAMPLES_GT9271_TOUCH_TEST
```

## r528/vendor_drivers/boards/r528/drivers/Kconfig
```kconfig
#
# For a description of the syntax of this configuration file,
# see the file kconfig-language.txt in the NuttX tools repository.
#

config GT911_IIC_TOUCH
	bool "GT911 LCD IIC Touchscreen Driver"
	default n
	depends on INPUT && DRIVERS_TWI
	select INPUT_TOUCHSCREEN
	---help---
		Enable GT911 LCD IIC touchscreen driver support.
		This driver provides touchscreen functionality for the GT911
		LCD module using capacitive touch controller over I2C interface.
		The driver automatically detects the touch controller type.

config GT9271_IIC_TOUCH
	bool "GT9271 LCD IIC Touchscreen Driver"
	default n
	depends on INPUT && DRIVERS_TWI
	select INPUT_TOUCHSCREEN
	---help---
		Enable GT9271 LCD IIC touchscreen driver support.
		Register-compatible with GT911 family, ported with coordinate
		scaling to 1200x1920 BOE panel and I2C failure recovery.

config HX83102_IIC_TOUCH
	bool "HX83102 LCD IIC Touchscreen Driver"
	default n
	depends on INPUT && DRIVERS_TWI && SCHED_LPWORK
	select INPUT_TOUCHSCREEN
	---help---
		Enable HX83102 (Himax) LCD IIC touchscreen driver support.
		Use the BOE module resident firmware and its 56-byte event reports.
		Host firmware download is not supported by this driver.
		Coordinate scaling/rotation targets the 1440x720 BOE panel.

source "drivers/platform/micro_sd/Kconfig"
source "drivers/platform/realtek_ieee80211/Kconfig"
```

## r528/vendor_drivers/chips/r528/drivers/rtos-hal/hal/source/disp2/disp/lcd/Kconfig
```kconfig
config LCD_SUPPORT_GG1P4062UTSW
	bool "LCD support cpu_gg1p4062utsw panel"
	default n
	---help---
		If you want to support cpu_gg1p4062utsw panel for display driver, select it.

config LCD_SUPPORT_DX0960BE40A1
	bool "LCD support dx0960be40a1 panel"
	default n
	---help---
		If you want to support dx0960be40a1 panel for display driver, select it.

config LCD_SUPPORT_TFT720X1280
	bool "LCD support dx0960be40a1 panel"
	default n
	---help---
		If you want to support dx0960be40a1 panel for display driver, select it.

config LCD_SUPPORT_FD055HD003S
	bool "LCD support fd055hd003s panel"
	default n
	---help---
		If you want to support fd055hd003s panel for display driver, select it.

config LCD_SUPPORT_HE0801A068
	bool "LCD support he0801a068 panel"
	default n
	---help---
		If you want to support he0801a068 panel for display driver, select it.

config LCD_SUPPORT_ILI9341
	bool "LCD support ili9341 panel"
	default n
	---help---
		If you want to support ili9341 panel for display driver, select it.

if LCD_SUPPORT_ILI9341
config LCD_ILI9341_HARDWARE_SPI
    bool "Use hardware SPI for ili9341"
	default y
    ---help---
      If you want to Use hardware SPI for ili9341, select it.
endif

config LCD_SUPPORT_LH219WQ1
	bool "LCD support LH219WQ1 panel"
	default n
	---help---
		If you want to support LH219WQ1 panel for display driver, select it.

config LCD_SUPPORT_LS029B3SX02
	bool "LCD support ls029b3sx02 panel"
	default n
	---help---
		If you want to support ls029b3sx02 panel for display driver, select it.

config LCD_SUPPORT_LT070ME05000
	bool "LCD support lt070me05000 panel"
	default n
	---help---
		If you want to support lt070me05000 panel for display driver, select it.


config LCD_SUPPORT_S6D7AA0X01
	bool "LCD support S6D7AA0X01 panel"
	default n
	---help---
		If you want to support S6D7AA0X01 panel for display driver, select it.


config LCD_SUPPORT_T27P06
	bool "LCD support t27p06 panel"
	default n
	---help---
		If you want to support t27p06 panel for display driver, select it.

config LCD_SUPPORT_TFT720_1280
	bool "LCD support tft720_1280 panel"
	default n
	---help---
		If you want to support tft720_1280 panel for display driver, select it.


config LCD_SUPPORT_WTQ05027D01
	bool "LCD support wtq05027d01 panel"
	default n
	---help---
		If you want to support wtq05027d01 panel for display driver, select it.

config LCD_SUPPORT_H245QBN02
	bool "LCD support H245QBN02 panel"
	default n
	---help---
		If you want to support H245QBN02 panel for display driver, select it.

config LCD_SUPPORT_ST7789V
	bool "LCD support ST7789V panel"
	default n
	---help---
		If you want to support ST7789V panel for display driver, select it.

config LCD_SUPPORT_ST7789
	bool "LCD support ST7789 panel"
	default n
	---help---
		If you want to support ST7789 panel for display driver, select it.

if LCD_SUPPORT_ST7789
config LCD_ST7789_HARDWARE_SPI
    bool "Use hardware SPI for st7789"
	default y
    ---help---
      If you want to Use hardware SPI for st7789, select it.
endif

config LCD_SUPPORT_ST7796S
	bool "LCD support ST7796S panel"
	default n
	---help---
		If you want to support ST7796S panel for display driver, select it.

config LCD_SUPPORT_ST7701S
	bool "LCD support ST7701S panel"
	select FB_UPDATE
	default n
	---help---
		If you want to support ST7701S panel for display driver, select it.

config LCD_SUPPORT_T30P106
	bool "LCD support T30P106 panel"
	default n
	---help---
		If you want to support T30P106 panel for display driver, select it.

config LCD_SUPPORT_TO20T20000
	bool "LCD support TO20T20000 panel"
	default n
	---help---
		If you want to support TO20T20000 panel for display driver, select it.

config LCD_SUPPORT_FRD450H40014
	bool "LCD support FRD450H40014 panel"
	default n
	---help---
		If you want to support FRD450H40014 panel for display driver, select it.

config LCD_SUPPORT_S2003T46G
	bool "LCD support S2003T46G panel"
	default n
	---help---
		If you want to support S2003T46G panel for display driver, select it.

config LCD_SUPPORT_WILLIAMLCD
	bool "LCD support WilliamLcd panel"
	default n
	---help---
		If you want to support WilliamLcd panel for display driver, select it.

config LCD_SUPPORT_LQ101R1SX03
	bool "LCD support lq101r1sx03 panel"
	default n
	---help---
		If you want to support lq101r1sx03 panel for display driver, select it.

config LCD_SUPPORT_INET_DSI_PANEL
	bool "LCD support inet_dsi_panel panel"
	default n
	---help---
		If you want to support inet_dsi_panel panel for display driver, select it.

config LCD_SUPPORT_WTL096601G03
	bool "LCD support WTL096601G03 panel"
	default n
	---help---
		If you want to support WTL096601G03 panel for display driver, select it.

config LCD_SUPPORT_RT13QV005D
	bool "LCD support rt13qv005d panel"
	default n
	---help---
		If you want to support rt13qv005d panel for display driver, select it.
config LCD_SUPPORT_ST7789V_CPU
	bool "LCD support st7789v_cpu panel"
	default n
	---help---
		If you want to support st7789v_cpu panel for display driver, select it.

config LCD_SUPPORT_VVX07H005A10
	bool "LCD support VVX07H005A10 panel"
	default n
	---help---
		If you want to support VVX07H005A10 panel for display driver, select it.

config LCD_SUPPORT_TFT08006
	bool "LCD support TFT08006 panel"
	select FB_UPDATE
	default n
	---help---
		If you want to support TFT08006 panel for display driver, select it.

 config LCD_SUPPORT_ZJY4305
    bool "LCD support ZJY4305 panel"
     select FB_UPDATE
     default n
     ---help---
         If you want to support ZJY4305 panel for display driver, select it.

config LCD_SUPPORT_B080UAN01_MIPI1200X1920
	bool "LCD support b080uan01 mipi 1200x1920 panel"
	default n
	---help---
		If you want to support b080uan01 mipi 1200x1920 panel for display driver, select it.
config LCD_SUPPORT_GC9503CV
	bool "LCD support gc9503cv mipi 480x800 panel"
	select FB_UPDATE
	default n
	---help---
		If you want to support b080uan01 mipi 1200x1920 panel for display driver, select it.
config LCD_SUPPORT_T070S140B
    bool "LCD support T070S140B panel"
	select FB_UPDATE
    default n
    ---help---
      If you want to Support  T070S140B mipi 1024x600  panel for display driver, select it.
config LCD_SUPPORT_BOE_1200X1920
    bool "LCD support BOE 1200x1920 panel"
	select FB_UPDATE
    default n
    ---help---
      If you want to Support  BOE_1200x1920 mipi 1200x1920 panel for display driver, select it.
config LCD_SUPPORT_SSD1306
    bool "LCD support SSD1306 panel"
    default n
    ---help---
      If you want to Support  SSD1306 panel for display driver, select it.

if LCD_SUPPORT_SSD1306

choice
prompt "Select SPI interface type for SSD1306"
default LCD_SSD1306_SPI_HW

config LCD_SSD1306_SPI_HW
    bool "Use hardware SPI for SSD1306"
    ---help---
      If you want to Use hardware SPI for SSD1306, select it.
config LCD_SSD1306_SPI_SW
    bool "Use software SPI for SSD1306"
    ---help---
      If you want to Use software SPI for SSD1306, select it.
endchoice

config LCD_SSD1306_TEST
    bool "test for SSD1306"
    default n
    ---help---
      If you want to test SSD1306 panel for display driver, select it.
endif # LCD_SUPPORT_SSD1306
```

## r528/vendor_drivers/chips/r528/drivers/rtos-hal/hal/source/disp2/soc/Kconfig
```kconfig
#

menu "Board Select"

config V459_PERF1
	bool "board v459 perf1"
	default n
	---help---
	  board v459 perf1

config F133_FPGA
	bool "board fpga f133"
	default n
	---help---
	  board f133 fpga

config VVX07H005A10_MIPI
	bool "board, disp with VVX07H005A10_mipi"
	default n
	---help---
	  board, disp with VVX07H005A10_mipi

config HE0801A068_MIPI
	bool "EVB board, disp with HE0801A068_MIPI"
	default n
	---help---
	  EVB board, disp with HE0801A068_MIPI
config GC9503CV_MIPI_EVB2
	bool "EVB2 board, disp with GC9503CV_MIPI"
	default n
	---help---
	  EVB2 board, disp with GC9503CV_MIPI
config GC9503CV_MIPI_EVB4
	bool "EVB4 board, disp with GC9503CV_MIPI"
	default n
	---help---
	  EVB4 board, disp with GC9503CV_MIPI
config DEFAULT_LVDS
	bool "board, disp with lvds"
	default n
	---help---
	  board, disp with lvds

config T070S140B_MIPI
	bool "board, disp with T070S140B MIPI"
	default n
	---help---
	  board, disp with T070S140B MIPI 1024x600 panel

config BOE_1200X1920_MIPI
	bool "board, disp with BOE 1200x1920 MIPI"
	default n
	---help---
	  board, disp with BOE MIPI 1200x1920 panel

config SSD1306_SPI
	bool "board, disp with SSD1306 SPI"
	default n
	---help---
	  board, disp with SSD1306 SPI 128x64 panel
endmenu

menu "Soc Select"

config ARCH_SUN8IW19
	bool "soc sun8iw19"
	default n
	---help---
	  soc sun8iw19

config ARCH_SUN8IW20
	bool "soc sun8iw20"
	default n
	---help---
	  soc sun8iw20

config ARCH_SUN20IW1
	bool "soc sun20iw1"
	default n
	---help---
	  soc sun20iw1

config ARCH_SUN20IW2
	bool "soc sun20iw2"
	default n
	---help---
	  soc sun20iw2

endmenu
```
